## net/mptcp/Kconfig
```kconfig
#
# MPTCP configuration
#
config MPTCP
        bool "MPTCP protocol"
        depends on !SYN_COOKIES && !TCP_MD5SIG
        ---help---
          This replaces the normal TCP stack with a Multipath TCP stack,
          able to use several paths at once.
```
